## board/freescale/imx6_truxd01_som/Kconfig
```kconfig
if TARGET_MX6_TRUXD01_SOM  || TARGET_MX6_TRUXD01_SOM_MFG

config SYS_BOARD
	default "imx6_truxd01_som"

config SYS_VENDOR
	default "freescale"

config SYS_CONFIG_NAME
	default "imx6_truxd01_som"

endif
```

## board/freescale/imx6_truxq01_som/Kconfig
```kconfig
if TARGET_MX6_TRUXQ01_SOM  || TARGET_MX6_TRUXQ01_SOM_MFG

config SYS_BOARD
	default "imx6_truxq01_som"

config SYS_VENDOR
	default "freescale"

config SYS_CONFIG_NAME
	default "imx6_truxq01_som"

endif
```

## configs/imx6_truxd01_som_defconfig
```kconfig
CONFIG_ARM=y
CONFIG_ARCH_MX6=y
CONFIG_TARGET_MX6_TRUXD01_SOM=y
CONFIG_SYS_EXTRA_OPTIONS="IMX_CONFIG=board/freescale/imx6_truxd01_som/imx6_truxd01.cfg"
CONFIG_CMD_GPIO=y
CONFIG_CMD_DHCP=y
CONFIG_CMD_PING=y
```
